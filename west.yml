## west.yml
```yaml
# Copyright (c) 2026 Vestas Wind Systems A/S
# SPDX-License-Identifier: Apache-2.0

manifest:
  remotes:
    - name: zephyrproject-rtos
      url-base: https://github.com/zephyrproject-rtos
  projects:
    - name: zephyr
      remote: zephyrproject-rtos
      revision: main
      clone-depth: 1
      import:
        name-allowlist:
          - cmsis_6
          - hal_nxp
          - mbedtls
          - mcuboot
          - tf-psa-crypto
```
